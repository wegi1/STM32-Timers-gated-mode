# file: TIMERS_TRY.ioc
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Mcu.Family=STM32F1
Mcu.Name=STM32F103C(8-B)Tx
Mcu.Package=LQFP48
NVIC.PriorityGroup=NVIC_PRIORITYGROUP_4
NVIC.TIM4_IRQn=true\:15\:0\:false\:false\:true\:false\:true\:true
NVIC.TimeBase=TIM4_IRQn
NVIC.TimeBaseIP=TIM4
PA0-WKUP.Signal=S_TIM2_CH1_ETR
PA13.Mode=Serial_Wire
PA13.Signal=SYS_JTMS-SWDIO
PA14.Mode=Serial_Wire
PA14.Signal=SYS_JTCK-SWCLK
PD0-OSC_IN.Mode=HSE-External-Oscillator
PD0-OSC_IN.Signal=RCC_OSC_IN
PD1-OSC_OUT.Mode=HSE-External-Oscillator
PD1-OSC_OUT.Signal=RCC_OSC_OUT
ProjectManager.HeapSize=0x400
ProjectManager.StackSize=0x800
ProjectManager.TargetToolchain=STM32CubeIDE
RCC.AHBFreq_Value=72000000
RCC.APB1CLKDivider=RCC_HCLK_DIV2
RCC.APB1Freq_Value=36000000
RCC.APB1TimFreq_Value=72000000
RCC.APB2Freq_Value=72000000
RCC.APB2TimFreq_Value=72000000
RCC.HCLKFreq_Value=72000000
RCC.PLLMUL=RCC_PLL_MUL9
RCC.PLLSourceVirtual=RCC_PLLSOURCE_HSE
RCC.SYSCLKFreq_VALUE=72000000
RCC.SYSCLKSource=RCC_SYSCLKSOURCE_PLLCLK
RCC.USBFreq_Value=72000000
SH.S_TIM2_CH1_ETR.0=TIM2_ETR,ClockSourceETR_Mode2
TIM2.TIM_MasterOutputTrigger=TIM_TRGO_UPDATE
TIM2.TIM_MasterSlaveMode=TIM_MASTERSLAVEMODE_ENABLE
TIM3.Channel-PWM\ Generation1\ No\ Output=TIM_CHANNEL_1
TIM3.Period=11000
TIM3.Prescaler=7200-1
TIM3.Pulse-PWM\ Generation1\ No\ Output=10000-1
TIM3.TIM_MasterOutputTrigger=TIM_TRGO_OC1REF
TIM3.TIM_MasterSlaveMode=TIM_MASTERSLAVEMODE_ENABLE
VP_SYS_VS_tim4.Mode=TIM4
VP_TIM1_VS_ClockSourceITR.Mode=TriggerSource_ITR1
VP_TIM1_VS_ControllerModeClock.Mode=Clock Mode
VP_TIM2_VS_ClockSourceITR.Mode=TriggerSource_ITR2
VP_TIM2_VS_ControllerModeGated.Mode=Gated Mode
VP_TIM3_VS_ClockSourceINT.Mode=Internal
VP_TIM3_VS_no_output1.Mode=PWM Generation1 No Output
board=custom

// file: Core/Src/main.c
/* USER CODE BEGIN Header */
/**
 ******************************************************************************
 * @file           : main.c
 * @brief          : Main program body
 ******************************************************************************
 * @attention
 *
 * Copyright (c) 2023 STMicroelectronics.
 * All rights reserved.
 *
 * This software is licensed under terms that can be found in the LICENSE file
 * in the root directory of this software component.
 * If no LICENSE file comes with this software, it is provided AS-IS.
 *
 ******************************************************************************
 */
/* USER CODE END Header */
#include "main.h"

/* USER CODE BEGIN Includes */
#include "uart.h"
#include <stdio.h>
#include "rcc.h"
/* USER CODE END Includes */

TIM_HandleTypeDef htim1;
TIM_HandleTypeDef htim2;
TIM_HandleTypeDef htim3;

void SystemClock_Config(void);
static void MX_GPIO_Init(void);
static void MX_TIM1_Init(void);
static void MX_TIM2_Init(void);
static void MX_TIM3_Init(void);
/* USER CODE BEGIN PFP */

static void reg_print(void);

/* USER CODE END PFP */

int main(void)
{
    /* USER CODE BEGIN 1 */
    uint32_t data = 0;
    uint32_t data2 = 0;
    uint32_t i=0 ;
    uint32_t data3, data4;
    int first_timer, second_timer, third_timer;
    //******************************************
    // for blinking code (PC13)
    //******************************************
#define GPIOC_CRH_VALUE    0x44144444UL
#define GPIOC_ODR_ODR13    0x00002000UL
    RCC->APB2ENR |= RCC_APB2ENR_IOPCEN;
    GPIOC->CRH    = GPIOC_CRH_VALUE;
    BB(GPIOC->ODR, GPIO_ODR_ODR13) = 1; // Disable user diode
    //******************************************
    /* USER CODE END 1 */

    /* MCU Configuration--------------------------------------------------------*/

    /* Reset of all peripherals, Initializes the Flash interface and the Systick. */
    HAL_Init();

    /* Configure the system clock */
    SystemClock_Config();

    /* Initialize all configured peripherals */
    MX_GPIO_Init();
    MX_TIM1_Init();
    MX_TIM2_Init();
    MX_TIM3_Init();
    /* USER CODE BEGIN 2 */

    /* UART Configuration */
    uart_UART1_GPIO_config();
    uart_UART1_config();
    SysTick_Config(8000);

    static const char clr_scr[] = {"\033[2J\033[3J\033[92m\033[0;0f ...\r\n" \
            "\033[7;0fEXT Ticks going from TIMER2_ETR2 which is PA0"
    };

    printf(clr_scr);
    //printf(info1);

    // Enable counters
    TIM1->CR1 = 1; // high 16 bytes of 32 bit value of cascade counter
    TIM2->CR1 = 1; // low  16 bytes of 32 bit value of cascade counter
    TIM3->CR1 = 1; // start gating time of TIMER1

    /* USER CODE END 2 */

    /* Infinite loop */
    /* USER CODE BEGIN WHILE */
    while (1)
    {

        //******************************
        BB(GPIOC->ODR, GPIO_ODR_ODR13) ^= 1; // BLINK user diode
        //******************************

        // wait for gate off time
        while(TIM3->CNT < 10003);

        // now read gate time and 32bit cascade timer value
        first_timer = (TIM3->CNT & 0xFFFF);
        data = (TIM1->CNT << 16);
        data |= (TIM2->CNT & 0xFFFF);

        // repetition read counter
        i++;

        // calculate how many tick's incremented
        data2 = data - data2;

        // just for check gating time is work
        // wait for later gate off time
        while(TIM3->CNT < 10050);

        // now read gate time and 32bit cascade timer value
        second_timer = (TIM3->CNT & 0xFFFF);
        data3 = (TIM1->CNT << 16);
        data3 |= (TIM2->CNT & 0xFFFF);

        // print info and statistic our 32bit timer valueas and gating time
        printf("\033[1;0f                     " );
        printf("\033[1;0fAfter %d seconds" , (int) i);
        printf("\033[2;0fTIM3->CNT = %d" , first_timer) ;
        printf("\033[3;0f                       " );
        printf("\033[3;0fTimer Value = %d" , (int) data);
        printf("\033[4;0fTIM3->CNT = %d [Under GATING OFF time]" , second_timer) ;
        printf("\033[5;0f                                  " );
        printf("\033[5;0fTimer Value = %d [GATE OFF]" , (int) data3);
        printf("\033[6;0f                               " );
        printf("\033[6;0f1s. EXT Ticks Count = %d" , (int) data2);

        // for future incremented tick's calculations
        data2 = data;

        // show most interesting timers registers values
        reg_print();

        // just for check gating time is work
        // wait for 10% gate on time
        while(TIM3->CNT > 500);
        while(TIM3->CNT < 500);

        // now read gate time and 32bit cascade timer value
        third_timer = (TIM3->CNT & 0xFFFF);
        data4 = (TIM1->CNT << 16);
        data4 |= (TIM2->CNT & 0xFFFF);

        // print info and statistic our 32bit timer valueas and gating time
        printf("\033[17;0fTIM3->CNT = %d [Under 5%% GATE ON time]" , third_timer) ;
        printf("\033[18;0f                                     " );
        printf("\033[18;0fTimer Incremented = %d [GATE ON]" , (int) (data4-data2));
        printf("\033[19;0fTIM3->CNT = %d" , (int) TIM3->CNT) ;
        printf("\r\n");

        /* USER CODE END WHILE */

    }
}

void SystemClock_Config(void)
{
    RCC_OscInitTypeDef RCC_OscInitStruct = {0};
    RCC_ClkInitTypeDef RCC_ClkInitStruct = {0};

    /** Initializes the RCC Oscillators according to the specified parameters
     * in the RCC_OscInitTypeDef structure.
     */
    RCC_OscInitStruct.OscillatorType = RCC_OSCILLATORTYPE_HSE;
    RCC_OscInitStruct.HSEState = RCC_HSE_ON;
    RCC_OscInitStruct.HSEPredivValue = RCC_HSE_PREDIV_DIV1;
    RCC_OscInitStruct.HSIState = RCC_HSI_ON;
    RCC_OscInitStruct.PLL.PLLState = RCC_PLL_ON;
    RCC_OscInitStruct.PLL.PLLSource = RCC_PLLSOURCE_HSE;
    RCC_OscInitStruct.PLL.PLLMUL = RCC_PLL_MUL9;
    if (HAL_RCC_OscConfig(&RCC_OscInitStruct) != HAL_OK)
    {
        Error_Handler();
    }

    /** Initializes the CPU, AHB and APB buses clocks
     */
    RCC_ClkInitStruct.ClockType = RCC_CLOCKTYPE_HCLK|RCC_CLOCKTYPE_SYSCLK
            |RCC_CLOCKTYPE_PCLK1|RCC_CLOCKTYPE_PCLK2;
    RCC_ClkInitStruct.SYSCLKSource = RCC_SYSCLKSOURCE_PLLCLK;
    RCC_ClkInitStruct.AHBCLKDivider = RCC_SYSCLK_DIV1;
    RCC_ClkInitStruct.APB1CLKDivider = RCC_HCLK_DIV2;
    RCC_ClkInitStruct.APB2CLKDivider = RCC_HCLK_DIV1;

    if (HAL_RCC_ClockConfig(&RCC_ClkInitStruct, FLASH_LATENCY_2) != HAL_OK)
    {
        Error_Handler();
    }
}

static void MX_TIM1_Init(void)
{

    TIM_SlaveConfigTypeDef sSlaveConfig = {0};
    TIM_MasterConfigTypeDef sMasterConfig = {0};

    htim1.Instance = TIM1;
    htim1.Init.Prescaler = 0;
    htim1.Init.CounterMode = TIM_COUNTERMODE_UP;
    htim1.Init.Period = 65535;
    htim1.Init.ClockDivision = TIM_CLOCKDIVISION_DIV1;
    htim1.Init.RepetitionCounter = 0;
    htim1.Init.AutoReloadPreload = TIM_AUTORELOAD_PRELOAD_DISABLE;
    if (HAL_TIM_Base_Init(&htim1) != HAL_OK)
    {
        Error_Handler();
    }
    sSlaveConfig.SlaveMode = TIM_SLAVEMODE_EXTERNAL1;
    sSlaveConfig.InputTrigger = TIM_TS_ITR1;
    if (HAL_TIM_SlaveConfigSynchro(&htim1, &sSlaveConfig) != HAL_OK)
    {
        Error_Handler();
    }
    sMasterConfig.MasterOutputTrigger = TIM_TRGO_RESET;
    sMasterConfig.MasterSlaveMode = TIM_MASTERSLAVEMODE_DISABLE;
    if (HAL_TIMEx_MasterConfigSynchronization(&htim1, &sMasterConfig) != HAL_OK)
    {
        Error_Handler();
    }

}

static void MX_TIM2_Init(void)
{

    TIM_ClockConfigTypeDef sClockSourceConfig = {0};
    TIM_SlaveConfigTypeDef sSlaveConfig = {0};
    TIM_MasterConfigTypeDef sMasterConfig = {0};

    htim2.Instance = TIM2;
    htim2.Init.Prescaler = 0;
    htim2.Init.CounterMode = TIM_COUNTERMODE_UP;
    htim2.Init.Period = 65535;
    htim2.Init.ClockDivision = TIM_CLOCKDIVISION_DIV1;
    htim2.Init.AutoReloadPreload = TIM_AUTORELOAD_PRELOAD_DISABLE;
    if (HAL_TIM_Base_Init(&htim2) != HAL_OK)
    {
        Error_Handler();
    }
    sClockSourceConfig.ClockSource = TIM_CLOCKSOURCE_ETRMODE2;
    sClockSourceConfig.ClockPolarity = TIM_CLOCKPOLARITY_NONINVERTED;
    sClockSourceConfig.ClockPrescaler = TIM_CLOCKPRESCALER_DIV1;
    sClockSourceConfig.ClockFilter = 0;
    if (HAL_TIM_ConfigClockSource(&htim2, &sClockSourceConfig) != HAL_OK)
    {
        Error_Handler();
    }
    sSlaveConfig.SlaveMode = TIM_SLAVEMODE_GATED;
    sSlaveConfig.InputTrigger = TIM_TS_ITR2;
    if (HAL_TIM_SlaveConfigSynchro(&htim2, &sSlaveConfig) != HAL_OK)
    {
        Error_Handler();
    }
    sMasterConfig.MasterOutputTrigger = TIM_TRGO_UPDATE;
    sMasterConfig.MasterSlaveMode = TIM_MASTERSLAVEMODE_ENABLE;
    if (HAL_TIMEx_MasterConfigSynchronization(&htim2, &sMasterConfig) != HAL_OK)
    {
        Error_Handler();
    }

}

static void MX_TIM3_Init(void)
{

    TIM_ClockConfigTypeDef sClockSourceConfig = {0};
    TIM_MasterConfigTypeDef sMasterConfig = {0};
    TIM_OC_InitTypeDef sConfigOC = {0};

    htim3.Instance = TIM3;
    htim3.Init.Prescaler = 7200-1;
    htim3.Init.CounterMode = TIM_COUNTERMODE_UP;
    htim3.Init.Period = 11000;
    htim3.Init.ClockDivision = TIM_CLOCKDIVISION_DIV1;
    htim3.Init.AutoReloadPreload = TIM_AUTORELOAD_PRELOAD_DISABLE;
    if (HAL_TIM_Base_Init(&htim3) != HAL_OK)
    {
        Error_Handler();
    }
    sClockSourceConfig.ClockSource = TIM_CLOCKSOURCE_INTERNAL;
    if (HAL_TIM_ConfigClockSource(&htim3, &sClockSourceConfig) != HAL_OK)
    {
        Error_Handler();
    }
    if (HAL_TIM_PWM_Init(&htim3) != HAL_OK)
    {
        Error_Handler();
    }
    sMasterConfig.MasterOutputTrigger = TIM_TRGO_OC1REF;
    sMasterConfig.MasterSlaveMode = TIM_MASTERSLAVEMODE_ENABLE;
    if (HAL_TIMEx_MasterConfigSynchronization(&htim3, &sMasterConfig) != HAL_OK)
    {
        Error_Handler();
    }
    sConfigOC.OCMode = TIM_OCMODE_PWM1;
    sConfigOC.Pulse = 10000-1;
    sConfigOC.OCPolarity = TIM_OCPOLARITY_HIGH;
    sConfigOC.OCFastMode = TIM_OCFAST_DISABLE;
    if (HAL_TIM_PWM_ConfigChannel(&htim3, &sConfigOC, TIM_CHANNEL_1) != HAL_OK)
    {
        Error_Handler();
    }

}

static void MX_GPIO_Init(void)
{

    /* GPIO Ports Clock Enable */
    __HAL_RCC_GPIOD_CLK_ENABLE();
    __HAL_RCC_GPIOA_CLK_ENABLE();

}

/* USER CODE BEGIN 4 */

static void reg_print(void)
{
    printf("\033[9;0fTIM3->CNT = %d" , (int) TIM3->CNT) ;

    printf("\033[10;0fTIM1->CCER = 0x%X  | TIM2->CCER = 0x%X    | TIM3->CCER = 0x%X" , (int) TIM1->CCER, (int) TIM2->CCER, (int) TIM3->CCER) ;
    printf("\033[11;0fTIM1->SMCR = 0x%X | TIM2->SMCR = 0x%X | TIM3->SMCR = 0x%X" , (int) TIM1->SMCR, (int) TIM2->SMCR, (int) TIM3->SMCR) ;
    printf("\033[12;0fTIM1->CR2  = 0x%X  | TIM2->CR2  = 0x%X   | TIM3->CR2  = 0x%X" , (int) TIM1->CR2, (int) TIM2->CR2, (int) TIM3->CR2) ;
    printf("\033[13;0fTIM1->SR   = 0x%X | TIM2->SR   = 0x%X   | TIM3->SR   = 0x%X" , (int) TIM1->SR, (int) TIM2->SR, (int) TIM3->SR) ;
    printf("\033[14;0fTIM1->CR1  = 0x%X  | TIM2->CR1  = 0x%X    | TIM3->CR1  = 0x%X" , (int) TIM1->CR1, (int) TIM2->CR1, (int) TIM3->CR1) ;

    printf("\033[15;0fTIM3->CNT = %d" , (int) TIM3->CNT) ;

    //printf("\r\n");
}

/************************************************/
void gpio_pin_cfg(GPIO_TypeDef * const port, GpioPin_t pin, GpioMode_t mode)
{
    pin = __builtin_ctz(pin)*4;
    uint32_t volatile * cr_reg;
    uint32_t cr_val;
    cr_reg = &port->CRL;
    if (pin > 28){
        pin -= 32;
        cr_reg = &port->CRH;
    }
    cr_val = *cr_reg;
    cr_val &= ~((uint32_t)(0x0f << pin));
    cr_val |= (uint32_t)(mode << pin);
    *cr_reg = cr_val;
}
/* USER CODE END 4 */

void HAL_TIM_PeriodElapsedCallback(TIM_HandleTypeDef *htim)
{
    if (htim->Instance == TIM4) {
        HAL_IncTick();
    }
}

void Error_Handler(void)
{
    __disable_irq();
    while (1)
    {
    }
}
